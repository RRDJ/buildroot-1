## package/sunxi-mali-mainline/Config.in
```kconfig
config BR2_PACKAGE_SUNXI_MALI_MAINLINE
	bool "sunxi-mali-mainline"
	depends on BR2_aarch64 || (BR2_ARM_EABIHF && BR2_arm)
	depends on BR2_TOOLCHAIN_USES_GLIBC
	select BR2_PACKAGE_HAS_LIBEGL
	select BR2_PACKAGE_HAS_LIBGLES
	help
	  Install userspace Allwinner OpenGL libraries.

	  https://github.com/bootlin/mali-blobs

if BR2_PACKAGE_SUNXI_MALI_MAINLINE

config BR2_PACKAGE_PROVIDES_LIBEGL
	default "sunxi-mali-mainline"

config BR2_PACKAGE_PROVIDES_LIBGLES
	default "sunxi-mali-mainline"

choice
	prompt "Version"
	default BR2_PACKAGE_SUNXI_MALI_MAINLINE_R6P2
	help
	  Select the version of the userspace module.

config BR2_PACKAGE_SUNXI_MALI_MAINLINE_R6P2
	bool "r6p2"
config BR2_PACKAGE_SUNXI_MALI_MAINLINE_R8P1
	bool "r8p1"

endchoice

config BR2_PACKAGE_SUNXI_MALI_MAINLINE_REVISION
	string
	default "r6p2"	if BR2_PACKAGE_SUNXI_MALI_MAINLINE_R6P2
	default "r8p1"	if BR2_PACKAGE_SUNXI_MALI_MAINLINE_R8P1

choice
	prompt "Blob type"
	default BR2_PACKAGE_SUNXI_MALI_MAINLINE_FBDEV
	help
	  Select the type of blobs and headers.

config BR2_PACKAGE_SUNXI_MALI_MAINLINE_FBDEV
	bool "fbdev"
config BR2_PACKAGE_SUNXI_MALI_MAINLINE_X11
	bool "x11"
config BR2_PACKAGE_SUNXI_MALI_MAINLINE_WAYLAND
	bool "wayland"
	select BR2_PACKAGE_HAS_LIBEGL_WAYLAND

endchoice

config BR2_PACKAGE_SUNXI_MALI_MAINLINE_BLOB_TYPE
	string
	default "fbdev"		if BR2_PACKAGE_SUNXI_MALI_MAINLINE_FBDEV
	default "x11"		if BR2_PACKAGE_SUNXI_MALI_MAINLINE_X11
	default "wayland"	if BR2_PACKAGE_SUNXI_MALI_MAINLINE_WAYLAND

endif

comment "sunxi-mali needs an EABIhf glibc toolchain"
	depends on BR2_arm
	depends on !BR2_TOOLCHAIN_USES_GLIBC || !BR2_ARM_EABIHF
```
